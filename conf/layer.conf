## conf/layer.conf
```bitbake
# We have a conf and classes directory, add to BBPATH
BBPATH =. "${LAYERDIR}:"

# We have recipes-* directories, add to BBFILES
BBFILES += "${LAYERDIR}/recipes-*/*/*.bb \
            ${LAYERDIR}/recipes-*/*/*.bbappend"

BBFILE_COLLECTIONS += "remote-estei"
BBFILE_PATTERN_remote-estei = "^${LAYERDIR}/"
BBFILE_PRIORITY_remote-estei = "5"

# This should only be incremented on significant changes that will
# cause compatibility issues with other layers
LAYERVERSION_start = "1"
```
